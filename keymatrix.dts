/dts-v1/;
/plugin/;

#include <dt-bindings/gpio/meson-g12a-gpio.h>
#include <dt-bindings/gpio/gpio.h>

/{
	fragment@0 {
		target-path = "/";

		__overlay__ {
			matrix_keypad: matrix-keypad {
				compatible = "gpio-matrix-keypad";
				col-gpios = <
					&gpio GPIOX_3 GPIO_ACTIVE_HIGH
					&gpio GPIOX_4 GPIO_ACTIVE_HIGH
					&gpio GPIOX_0 GPIO_ACTIVE_HIGH
					&gpio GPIOX_1 GPIO_ACTIVE_HIGH
					>;
				row-gpios = <
					&gpio GPIOX_8 GPIO_ACTIVE_HIGH
					&gpio GPIOX_9 GPIO_ACTIVE_HIGH
					&gpio GPIOX_2 GPIO_ACTIVE_HIGH
					>;
				/* sample keymap */
				linux,keymap = <
					0x000000a5 /* row 0, col 0, KEY_PREVIOUSSONG */
					0x00010072 /* row 0, col 1, KEY_VOLUMEDOWN */
					0x0003002a /* row 0, col 3, KEY_LEFTSHIFT */
					0x010000a3 /* row 1, col 0, KEY_NEXTSONG */
					0x0101001d /* row 1, col 1, KEY_LEFTCTRL */
					0x0102006e /* row 1, col 2, KEY_INSERT */
					0x01030036 /* row 1, col 3, KEY_RIGHTSHIFT */
					0x02000071 /* row 2, col 0, KEY_MUTE */
					0x02010073 /* row 2, col 1, KEY_VOLUMEUP */
					0x02030061 /* row 2, col 3, KEY_RIGHTCTRL */
					>;
				gpio-activelow;
				debounce-delay-ms = <100>;
				col-scan-delay-us = <500>;
				col-switch-delay-ms = <20>;
				linux,no-autorepeat;
			};
		};
	};
};
